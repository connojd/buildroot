## package/ndvm/Config.in
```kconfig
config BR2_PACKAGE_NDVM
	bool "ndvm"
	depends on BR2_USE_MMU
	help
	  The network device virtual machine
```

## package/vpnvm/Config.in
```kconfig
config BR2_PACKAGE_VPNVM
	bool "vpnvm"
	depends on BR2_USE_MMU
	help
	  The VPN virtual machine
```
